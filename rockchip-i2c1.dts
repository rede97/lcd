/dts-v1/;
/plugin/;

/ {
	compatible = "rockchip,rk3288";

	fragment@1 {
		target = <&i2c1>;
		__overlay__ {
			status = "okay";
			lcd@27 {
				compatible = "pcflcd,pcf8574-lcd";
				reg = <0x27>;
				lcd,cols = <16>;
				lcd,rows = <2>;
				lcd,oled;
			};
		};
	};
};
